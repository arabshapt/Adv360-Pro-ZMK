## config/west.yml
```yaml
# manifest:
#   remotes:
#     - name: zmkfirmware
#       url-base: https://github.com/zmkfirmware
#     # - name: arabshapt
#     #   url-base: https://github.com/arabshapt
#     - name: refil
#       url-base: https://github.com/refil
#   projects:
#     - name: zmk
#       remote: refil
#       revision: adv360-z3.2
#       import: app/west.yml
#   self:
#     path: config
manifest:
  remotes:
    - name: zmkfirmware
      url-base: https://github.com/zmkfirmware
    - name: arabshapt
      url-base: https://github.com/arabshapt
  projects:
    - name: zmk
      remote: arabshapt
      revision: experim_3
      import: app/west.yml
  self:
    path: config
```
